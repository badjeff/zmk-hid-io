## Kconfig
```kconfig
# Sensor data simulator
#
# Copyright (c) 2019 Nordic Semiconductor
#
# SPDX-License-Identifier: LicenseRef-Nordic-5-Clause
#

config ZMK_HID_IO_LEGACY_ENDPOINT_API
    bool "Target a ZMK tree with the pre-rename endpoint API"
    help
      Build against a ZMK tree from before two endpoint API changes, rather
      than current ZMK:

        * the selected-endpoint accessor was zmk_endpoints_selected(), since
          renamed to zmk_endpoint_get_selected()
        * enum zmk_transport gained a ZMK_TRANSPORT_NONE member

      Leave this off for current ZMK.
    default n

config ZMK_HID_IO
    bool "Enable HID I/O"
    default n

config ZMK_HID_IO_MOUSE
    bool "Enable HID I/O Mouse"
    default n

config ZMK_HID_IO_JOYSTICK
    bool "Enable HID I/O Joystick"
    default n

config ZMK_HID_IO_OUTPUT
    bool "Enable HID I/O Output"
    default n

config ZMK_HID_IO_VOLUME_KNOB
    bool "Enable HID I/O Volume Knob"
    default n

config ZMK_HID_IO_BLE_JOYSTICK_REPORT_QUEUE_SIZE
    int "Max number of mouse HID reports to queue for sending over BLE"
    default 20

config ZMK_HID_IO_BLE_MOUSE_REPORT_QUEUE_SIZE
    int "Max number of mouse HID reports to queue for sending over BLE"
    default 20

config ZMK_HID_IO_OUTPUT_QUEUE_SIZE
    int "Maximum number of output events to allow queueing from HID"
    default 4

config ZMK_HID_IO_BLE_VOLUME_KNOB_REPORT_QUEUE_SIZE
    int "Max number of volume knob HID reports to queue for sending over BLE"
    default 8

DT_COMPAT_ZMK_INPUT_BEHAVIOR_FWD_TO_HID_IO := zmk,input-behavior-fwd-to-hid-io
config ZMK_INPUT_BEHAVIOR_FWD_TO_HID_IO
    bool
    default $(dt_compat_enabled,$(DT_COMPAT_ZMK_INPUT_BEHAVIOR_FWD_TO_HID_IO))

DT_COMPAT_ZMK_INPUT_PROCESSOR_FWD_TO_HID_IO := zmk,input-processor-fwd-to-hid-io
config ZMK_INPUT_PROCESSOR_FWD_TO_HID_IO
    bool
    default $(dt_compat_enabled,$(DT_COMPAT_ZMK_INPUT_PROCESSOR_FWD_TO_HID_IO))

module = ZMK_HID_IO
module-str = ZMK_HID_IO
source "${ZEPHYR_BASE}/subsys/logging/Kconfig.template.log_config"


DT_COMPAT_ZMK_BEHAVIOR_HID_IO_KEY_PRESS := zmk,behavior-hid-io-key-press

config ZMK_BEHAVIOR_HID_IO_KEY_PRESS
    bool
    default $(dt_compat_enabled,$(DT_COMPAT_ZMK_BEHAVIOR_HID_IO_KEY_PRESS))
```
