/*
 * Copyright (c) 2020 The ZMK Contributors
 *
 * SPDX-License-Identifier: MIT
 */

/ {
    behaviors {
        /omit-if-no-ref/ ibfthi: input_behavior_fwd_to_hid_io {
            compatible = "zmk,input-behavior-fwd-to-hid-io";
            #binding-cells = <0>;
            usage = <0>; // enum hid_io_usage: { 0:disabled, 1:mouse, 2:joystick }
        };
    };
};
