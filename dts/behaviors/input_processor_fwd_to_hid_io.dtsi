/*
 * Copyright (c) 2020 The ZMK Contributors
 *
 * SPDX-License-Identifier: MIT
 */

/ {
    /omit-if-no-ref/ zipfthi: input_processor_fwd_to_hid_io {
        compatible = "zmk,input-processor-fwd-to-hid-io";
        #input-processor-cells = <0>;
        usage = <0>; // enum hid_io_usage: { 0:disabled, 1:mouse, 2:joystick, 3:vol knob }
    };
};
