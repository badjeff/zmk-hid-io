## dts/bindings/zmk,behavior-hid-io-key-press.yaml
```yaml
description: HID IO key press behavior

compatible: "zmk,behavior-hid-io-key-press"

include: one_param.yaml
```

## dts/bindings/zmk,input-behavior-fwd-to-hid-io.yaml
```yaml
# Copyright (c) 2020 The ZMK Contributors
# SPDX-License-Identifier: MIT

description: Input Behavior To Intercept As HID IO Joystick Event

compatible: "zmk,input-behavior-fwd-to-hid-io"

include: zero_param.yaml

properties:
  usage:
    type: int
    default: 0
```

## dts/bindings/zmk,input-processor-fwd-to-hid-io.yaml
```yaml
# Copyright (c) 2020 The ZMK Contributors
# SPDX-License-Identifier: MIT

description: Input Processor To Intercept As HID IO Joystick Event

compatible: "zmk,input-processor-fwd-to-hid-io"

include: ip_zero_param.yaml

properties:
  usage:
    type: int
    default: 0
```
